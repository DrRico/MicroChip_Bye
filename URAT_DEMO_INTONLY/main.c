#include <stdio.h>
#include <reg52.h>
#include <stdlib.h>
#define MAX 17000          
#define MIN 14000           


code char sum_P0[16][13] = {{0x23,0x34,0x45,0x56,0x67,0x78,0x89,0x9a,0xab,0xbc,0xcd,0xde,0xef},
							{0x34,0x45,0x56,0x67,0x78,0x89,0x9a,0xab,0xbc,0xcd,0xde,0xef,0xf0},
							{0x45,0x56,0x67,0x78,0x89,0x9a,0xab,0xbc,0xcd,0xde,0xef,0xf0,0x01},
							{0x56,0x67,0x78,0x89,0x9a,0xab,0xbc,0xcd,0xde,0xef,0xf0,0x01,0x12},
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							{0x12,0x23,0x34,0x45,0x56,0x67,0x78,0x89,0x9a,0xab,0xbc,0xcd,0xde}};

code char sum_P2[16] = {0x01,0x12,0x23,0x34,0x45,0x56,0x67,0x78,0x89,0x9a,0xab,0xbc,0xcd,0xde,0xef,0xf0};

int i,j;
unsigned int adc1;
int volt1;

void InitUART(void)
{
    TH1 = 0xFD;	 
    TL1 = TH1;
    TMOD |= 0x20;	 
    SCON = 0x50;	
    ES = 1;			
    TR1 = 1;		
    TI = 1;			
}

void delay_ms(unsigned int t)
{
    unsigned char a,b;
    while(t--)
    {
      for(b=102;b>0;b--)
      for(a=3;a>0;a--);
    }
}
unsigned int random(void)
{
  unsigned int value,iii;
  for(iii=0;iii<100;iii++)
  {
    value = rand() % (MAX + 1- MIN) + MIN;             
  }
  return value;
}


void main()
{
    InitUART();
    EA = 1;	  	
    while(1)
    {
        //delay_ms(500);
        //printf("Hello World!\n");
		for(j=0;j<16;j++){
			for(i=0;i<13;i++){
				adc1 = random();
				//P0 = sum_P0[j][i];
				//P2 = sum_P2[j];
				//printf("j:%d----i:%d----P2:%x==",j,i,sum_P2[j]);
				//printf("==P0:%x====",sum_P0[j][i]);
				//delay_ms(150);
				/* ???????(?????),????,????? */
				//volt1 = ((unsigned long)adc1 * 5000) / 65535;
				
				/* ??ADC???? */	
				// printf("CH1=%5ld (%5dmV) \r CH2=%5ld (%5dmV)\r\n", (long int)adc1, volt1, (long int)adc2, volt2);
				
				//printf("CH1=%5ld (%5dmV) \r\n", (long int)adc1, volt1);
				printf("%5ld\n",(long int)adc1);


				delay_ms(500);
				
			}
		}
	while(1);
	}
}